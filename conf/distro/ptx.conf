## conf/distro/ptx.conf
```bitbake
DISTRO = "ptx"
DISTRO_NAME = "PTX - Poky (Yocto Project Reference Distro)"
DISTRO_VERSION = "4.0-0"
DISTRO_CODENAME = "ptx-kirkstone"

DISTROOVERRIDES =. "ptx:poky:"

MAINTAINER = "Pengutronix <ptx@pengutronix.de>"

LOCALCONF_VERSION = "2"

DISTRO_FEATURES = "argp ext2 largefile usbgadget usbhost wifi xattr nfs zeroconf multiarch systemd usrmerge"

# Select systemd as init manager
INIT_MANAGER ?= "systemd"

DISTRO_EXTRA_RDEPENDS += "packagegroup-core-boot ptx-profile"
DISTRO_EXTRA_RRECOMMENDS += "kernel-module-af-packet"

# do not include libc variant name in tmp directory
TCLIBCAPPEND = ""

# add build info file (/etc/build) to rootfs to ease traceability
INHERIT += "image-buildinfo"

# prepare to use icecc
# to enable icecc in your build, add ICECC_DISABLED = "" to your local.conf
INHERIT_DISTRO:append = " icecc"
ICECC_DISABLED ??= "1"

# add poky sanity bbclass
INHERIT += "poky-sanity"

require conf/distro/include/poky-world-exclude.inc
require conf/distro/include/no-static-libs.inc
require conf/distro/include/yocto-uninative.inc
require conf/distro/include/security_flags.inc
INHERIT += "uninative"

BB_SIGNATURE_HANDLER ?= "OEEquivHash"
BB_HASHSERVE ??= "auto"

# recommend ipk package management - make sure to comment or set it in local.conf.sample
PACKAGE_CLASSES ?= "package_ipk"
```

## conf/layer.conf
```bitbake
# We have a conf and classes directory, add to BBPATH
BBPATH .= ":${LAYERDIR}"

# We have recipes-* directories, add to BBFILES
BBFILES += "${LAYERDIR}/recipes-*/*/*.bb \
	${LAYERDIR}/recipes-*/*/*.bbappend"

BBFILE_COLLECTIONS += "ptx"
BBFILE_PATTERN_ptx = "^${LAYERDIR}/"
BBFILE_PRIORITY_ptx = "6"

LAYERSERIES_COMPAT_ptx = "dunfell gatesgarth"
```
